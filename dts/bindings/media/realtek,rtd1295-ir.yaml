## dts/bindings/media/realtek,rtd1295-ir.yaml
```yaml
# SPDX-License-Identifier: (GPL-2.0-only OR BSD-2-Clause)
%YAML 1.2
---
$id: http://devicetree.org/schemas/media/realtek,rtd1295-ir.yaml#
$schema: http://devicetree.org/meta-schemas/core.yaml#

title: Realtek RTD1295/RTD1296 IR receiver

maintainers:
  - Jalen Lin <jalen.lin@gmail.com>

description:
  The IR unit in the RTD1295/RTD1296 ISO block. It samples the receiver
  module's output into a FIFO (raw mode), which rc-core decodes; it also
  has hardware decoders, not described here.

allOf:
  - $ref: rc.yaml#

properties:
  compatible:
    const: realtek,rtd1295-ir

  reg:
    maxItems: 1

  interrupts:
    maxItems: 1

  clocks:
    items:
      - description: The unit's clock gate
      - description: The 27 MHz reference its sampling clock divides

  clock-names:
    items:
      - const: bus
      - const: ref

  resets:
    maxItems: 1

required:
  - compatible
  - reg
  - interrupts
  - clocks
  - clock-names
  - resets

unevaluatedProperties: false

examples:
  - |
    #include <dt-bindings/reset/realtek,rtd1295.h>

    ir@98007400 {
        compatible = "realtek,rtd1295-ir";
        reg = <0x98007400 0x100>;
        interrupt-parent = <&iso_irq_mux>;
        interrupts = <5>;
        clocks = <&iso_clk 7>, <&osc27M>;
        clock-names = "bus", "ref";
        resets = <&iso_reset RTD1295_ISO_RSTN_IR>;
        pinctrl-names = "default";
        pinctrl-0 = <&ir_rx_pins>;
        linux,rc-map-name = "rc-empty";
    };
...
```

## dts/bindings/net/realtek,rtd1295-hwnat.yaml
```yaml
# SPDX-License-Identifier: (GPL-2.0-only OR BSD-2-Clause)
%YAML 1.2
---
$id: http://devicetree.org/schemas/net/realtek,rtd1295-hwnat.yaml#
$schema: http://devicetree.org/meta-schemas/core.yaml#

title: Realtek RTD1295/RTD1296 hardware NAT switch core as a NIC

maintainers:
  - Jalen Lin <jalen.lin@gmail.com>

description: |
  The RTD1295 and RTD1296 SoCs have a hardware NAT engine: an RTL8197F-style
  switch core with a CPU port, behind which sit up to three external ports
  (MAC0: RGMII1 or SGMII, MAC4: the embedded GPHY, MAC5: RGMII0). This
  binding describes it used as a plain network interface on port 5
  (RGMII0) with an external PHY, the switch bridging only that port and
  the CPU. The embedded GPHY is left to the SoC's ordinary GMAC.

allOf:
  - $ref: ethernet-controller.yaml#

properties:
  compatible:
    const: realtek,rtd1295-hwnat

  reg:
    description: The whole NAT block, switch tables and CPU interface.
    maxItems: 1

  interrupts:
    maxItems: 1

  clocks:
    description: The NAT clock gate (CRT CLK_EN2 bit 0).
    maxItems: 1

  resets:
    description: The NAT block reset (CRT SOFT_RESET1 bit 1).
    maxItems: 1

  realtek,sb2:
    $ref: /schemas/types.yaml#/definitions/phandle
    description:
      The SB2 system controller, which holds the RGMII0 pad mux, drive and
      slew-rate registers.

  phy-mode:
    enum:
      - rgmii
      - rgmii-id
      - rgmii-rxid
      - rgmii-txid

  mdio:
    $ref: mdio.yaml#
    unevaluatedProperties: false
    description:
      The switch core's MDIO controller. It drives the pins of the port
      whose external PHY address matches, so the PHY must be the one on
      port 5.

required:
  - compatible
  - reg
  - interrupts
  - clocks
  - resets
  - realtek,sb2
  - phy-mode
  - phy-handle
  - mdio

unevaluatedProperties: false

examples:
  - |
    #include <dt-bindings/interrupt-controller/arm-gic.h>
    #include <dt-bindings/reset/realtek,rtd1295.h>

    ethernet@98060000 {
        compatible = "realtek,rtd1295-hwnat";
        reg = <0x98060000 0x170000>;
        interrupts = <GIC_SPI 24 IRQ_TYPE_LEVEL_HIGH>;
        clocks = <&crt_clk 32>;
        resets = <&reset1 RTD1295_RSTN_NAT>;
        realtek,sb2 = <&sb2>;
        phy-mode = "rgmii-id";
        phy-handle = <&nat_phy>;

        mdio {
            #address-cells = <1>;
            #size-cells = <0>;

            nat_phy: ethernet-phy@1 {
                reg = <1>;
                realtek,clkout-disable;
            };
        };
    };
...
```

## dts/bindings/phy/realtek,rtd1295-sata-phy.yaml
```yaml
# SPDX-License-Identifier: (GPL-2.0-only OR BSD-2-Clause)
%YAML 1.2
---
$id: http://devicetree.org/schemas/phy/realtek,rtd1295-sata-phy.yaml#
$schema: http://devicetree.org/meta-schemas/core.yaml#

title: Realtek RTD1295/RTD1296 SATA PHY

maintainers:
  - Jalen Lin <jalen.lin@gmail.com>

description: |
  The two SATA PHYs of the RTD1295/RTD1296 AHCI controller, one per port.
  They are programmed through an MDIO controller in the AHCI block's
  wrapper registers (the last 256 bytes of its 4 KiB window), and enabled
  through bits in the SB2 system controller. The PHY specifier is the
  port number. A PHY whose "phyN" reset is not given is not provided.

properties:
  compatible:
    const: realtek,rtd1295-sata-phy

  reg:
    description: The AHCI block's wrapper registers.
    maxItems: 1

  clocks:
    minItems: 1
    items:
      - description: SATA_ALIVE_0, for PHY 0
      - description: SATA_ALIVE_1, for PHY 1

  clock-names:
    minItems: 1
    items:
      - const: alive0
      - const: alive1

  resets:
    minItems: 2
    items:
      - description: PHY 0
      - description: PHY 0 power
      - description: PHY 1
      - description: PHY 1 power

  reset-names:
    minItems: 2
    items:
      - const: phy0
      - const: pow0
      - const: phy1
      - const: pow1

  realtek,sb2:
    $ref: /schemas/types.yaml#/definitions/phandle
    description:
      The SB2 system controller, which holds the PHYs' bandgap, bias and
      termination enables, PHY 0's SATA/SGMII select and the chip revision
      (the RX settings depend on it).

  '#phy-cells':
    const: 1

required:
  - compatible
  - reg
  - clocks
  - clock-names
  - resets
  - reset-names
  - realtek,sb2
  - '#phy-cells'

additionalProperties: false

examples:
  - |
    #include <dt-bindings/reset/realtek,rtd1295.h>

    phy@9803ff00 {
        compatible = "realtek,rtd1295-sata-phy";
        reg = <0x9803ff00 0x100>;
        clocks = <&crt_clk 7>, <&crt_clk 58>;
        clock-names = "alive0", "alive1";
        resets = <&reset1 RTD1295_RSTN_SATA_PHY_0>,
                 <&reset1 RTD1295_RSTN_SATA_PHY_POW_0>,
                 <&reset4 RTD1295_RSTN_SATA_PHY_1>,
                 <&reset4 RTD1295_RSTN_SATA_PHY_POW_1>;
        reset-names = "phy0", "pow0", "phy1", "pow1";
        realtek,sb2 = <&sb2>;
        #phy-cells = <1>;
    };
...
```
